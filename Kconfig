## Kconfig
```kconfig
config ZMK_BLE_MANAGEMENT
    bool "Enable BLE management feature"
    depends on ZMK_BLE

if ZMK_BLE_MANAGEMENT

config ZMK_BLE_MANAGEMENT_STUDIO_RPC
    bool "Enable BLE management custom Studio RPC"
    depends on ZMK_STUDIO

endif
```
